## main/Kconfig.projbuild
```kconfig
menu "Beurer BM54 Bridge"

    config BM54_BLE_ADDR
        string "BM54 BLE address (NimBLE little-endian, comma-separated hex bytes)"
        default "0xA1, 0x43, 0x73, 0xED, 0x7F, 0x0C"
        help
            Bluetooth MAC address of the target BM54 in NimBLE byte order
            (little-endian). Find it with nRF Connect or similar scanner.

            Example: if the MAC is 0C:7F:ED:73:43:A1, enter
            0xA1, 0x43, 0x73, 0xED, 0x7F, 0x0C

endmenu
```

## sdkconfig.defaults
```kconfig
# Target
CONFIG_IDF_TARGET="esp32h2"

# BLE - NimBLE stack
CONFIG_BT_ENABLED=y
CONFIG_BT_NIMBLE_ENABLED=y
CONFIG_BT_CONTROLLER_ENABLED=y
CONFIG_BT_NIMBLE_ROLE_CENTRAL=y
CONFIG_BT_NIMBLE_ROLE_OBSERVER=y
CONFIG_BT_NIMBLE_ROLE_PERIPHERAL=n
CONFIG_BT_NIMBLE_ROLE_BROADCASTER=n

# BLE security / bonding
CONFIG_BT_NIMBLE_SM_BONDING=y
CONFIG_BT_NIMBLE_SM_LEGACY=y
CONFIG_BT_NIMBLE_SM_SC=y
CONFIG_BT_NIMBLE_SM_MITM=n

# NVS for bond key persistence
CONFIG_NVS_FLASH=y

# Zigbee - end device (ZED)
CONFIG_ZB_ENABLED=y
CONFIG_ZB_ZED=y
CONFIG_ZB_BLE_COEX_ENABLE=y

# Zigbee network channel (adjust to match your coordinator)
CONFIG_ZB_TRANSCEIVER_ALL_CHANNELS_MASK=y

# Flash size (H2-mini-1 has 4MB)
CONFIG_ESPTOOLPY_FLASHSIZE_4MB=y
CONFIG_PARTITION_TABLE_CUSTOM=y
CONFIG_PARTITION_TABLE_CUSTOM_FILENAME="partitions.csv"

# Log level
CONFIG_LOG_DEFAULT_LEVEL_INFO=y
```
